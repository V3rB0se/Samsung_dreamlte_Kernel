## arch/arm64/configs/g950x_kor_defconfig
```kconfig
CONFIG_WLAN_REGION_CODE=200
CONFIG_TDMB=y
CONFIG_TDMB_VENDOR_FCI=y
# CONFIG_TDMB_FC8050 is not set
CONFIG_TDMB_FC8080=y
# CONFIG_TDMB_VENDOR_INC is not set
# CONFIG_TDMB_VENDOR_RAONTECH is not set
# CONFIG_TDMB_VENDOR_TELECHIPS is not set
# CONFIG_TDMB_QUALCOMM is not set
CONFIG_TDMB_SLSI=y
CONFIG_TDMB_SPI=y
# CONFIG_TDMB_EBI is not set
# CONFIG_TDMB_TSIF_SLSI is not set
# CONFIG_TDMB_TSIF_QC is not set
# CONFIG_TDMB_I2C is not set
CONFIG_TDMB_XTAL_FREQ=y
# CONFIG_TDMB_DEBUG is not set
# CONFIG_TDMB_ANT_DET is not set
# CONFIG_TDMB_VREG_SUPPORT is not set
```

## arch/arm64/configs/g955x_defconfig
```kconfig
# CONFIG_CAMERA_DREAM is not set
CONFIG_CAMERA_DREAM2=y
# CONFIG_POC_DREAM is not set
CONFIG_POC_DREAM2=y
# CONFIG_SENSORS_HRM_MAX86902 is not set
CONFIG_SENSORS_HRM_ADPD143=y
```

## arch/arm64/configs/g955x_kor_defconfig
```kconfig
CONFIG_WLAN_REGION_CODE=200
# CONFIG_CAMERA_DREAM is not set
CONFIG_CAMERA_DREAM2=y
CONFIG_TDMB=y
CONFIG_TDMB_VENDOR_FCI=y
# CONFIG_TDMB_FC8050 is not set
CONFIG_TDMB_FC8080=y
# CONFIG_TDMB_VENDOR_INC is not set
# CONFIG_TDMB_VENDOR_RAONTECH is not set
# CONFIG_TDMB_VENDOR_TELECHIPS is not set
# CONFIG_TDMB_QUALCOMM is not set
CONFIG_TDMB_SLSI=y
CONFIG_TDMB_SPI=y
# CONFIG_TDMB_EBI is not set
# CONFIG_TDMB_TSIF_SLSI is not set
# CONFIG_TDMB_TSIF_QC is not set
# CONFIG_TDMB_I2C is not set
CONFIG_TDMB_XTAL_FREQ=y
# CONFIG_TDMB_DEBUG is not set
# CONFIG_TDMB_ANT_DET is not set
# CONFIG_TDMB_VREG_SUPPORT is not set
# CONFIG_POC_DREAM is not set
CONFIG_POC_DREAM2=y
# CONFIG_SENSORS_HRM_MAX86902 is not set
CONFIG_SENSORS_HRM_ADPD143=y
```
